## config/boards/shields/fishsplit/Kconfig.shield
```kconfig
config FISHSPLIT_LEFT
    def_bool $(shields_list_contains,fishsplit_left)

config FISHSPLIT_RIGHT
    def_bool $(shields_list_contains,fishsplit_right)
```
